## Documentation/devicetree/bindings/misc/microtrust,utos.txt
```
Microtrust TEEI Feature

Required properties:
	- compatible: Should be "microtrust,utos"
	- interrupts: teei interrupt number and property

Examples:

	utos {
		compatible = "microtrust,utos";
		interrupts = <GIC_SPI 242 IRQ_TYPE_EDGE_RISING>,
			<GIC_SPI 243 IRQ_TYPE_EDGE_RISING>;
	};
```

## drivers/input/touchscreen/mediatek/focaltech_ft6336u/Kconfig
```kconfig
#
# Touchscreen driver configuration
#
config TOUCHSCREEN_MTK_FOCALTECH_FT6336U
    bool "Focaltech Ts for Mediatek"
    depends on I2C
    default n
    help
      Say Y here if you have Focaltech touch panel.
      If unsure, say N.
      
config TOUCHSCREEN_MTK_FTS_DIRECTORY
    string "Focaltech ts directory name"
    default "focaltech_touch"
    depends on TOUCHSCREEN_MTK_FOCALTECH_FT6336U

## hct-drv add for tpgesture by qhs begin ##
config HCT_GESTURE_SUPPORT
        bool "HCT_GESTURE_SUPPORT"
        default n
## hct-drv add for tpgesture by qhs end ##
    
```

## drivers/misc/mediatek/C7S/Kconfig
```kconfig
config CHARGER_CUTOFF
  bool "Charger cut-off"
  default n
  help
    Select Y here to enable charger cut-off at 4.2V.

config CPU_UNDERVOLT
  bool "CPU undervolt"
  default n
  help
    Select Y here to enable CPU underclock/undervolt.

config AMBIENT_DISPLAY
  bool "Ambient display driver"
  default n
  help
    Select Y here to enable the C7S/C8 ambient display driver.

menu "C7S Platform"
  config C7S_GPIO
    bool "C7S GPIO driver"
    default n
    help
      Select Y here to enable the C7S GPIO driver.

  if C7S_GPIO
    choice
      prompt "C7S Devices"

    config C7S_LEM12
      bool "C7S support for LEM12"
      help
        Select Y here to enable support for the Lemfo LEM12.

    config C7S_PRIME
      bool "C7S support for PRIME"
      help
        Select Y here to enable support for the Kospet Prime.

    config C7S_KIRIN
      bool "C7S support for KIRIN"
      help
        Select Y here to enable support for the Rollme S08.

    config C7S_HOPE
      bool "C7S support for HOPE"
      help
        Select Y here to enable support for the Kospet Hope.

    endchoice
  endif
endmenu

menu "C8 Platform"
  config C8_GPIO
    depends on !C7S_GPIO
    bool "C8 GPIO driver"
    default n
    help
      Select Y here to enable the C8 GPIO driver.

  if C8_GPIO
    choice
      prompt "C8 Devices"

    config C8_OPTIMUS
      bool "C8 support for OPTIMUS"
      help
        Select Y here to enable support for the Kospet Optimus Pro.

    endchoice
    source "drivers/misc/mediatek/C7S/nrf_control/Kconfig"
  endif
endmenu
```

## drivers/misc/mediatek/C7S/nrf_control/Kconfig
```kconfig
config C8_NRF_CONTROL
	bool "C8 NRF Control driver"
	depends on C8_GPIO
	default n
	help
	  Select Y here to enable the C8 nrf control driver.
```

## drivers/misc/mediatek/accelerometer/mpu6050g/Kconfig
```kconfig
config MTK_MPU6050G
	bool "MPU6050 gsensor support"
	default n
	help
		This configuration is for enable or disable MPU6050 accelerometer sensor support.
		Say Y here if you want to support this sensor.
		Say N if you not support it.
		If no sure, say N.
```

## drivers/misc/mediatek/gyroscope/mpu6050gy/Kconfig
```kconfig
config MTK_MPU6050GY
	bool "MPU6050 gyroscope sensor support"
	default n
	help
		This configuration is for enable or disable MPU6050 gyroscope sensor support.
		Say Y here if you want to support this sensor.
		Say N if you not support it.
		If no sure, say N.
```

## drivers/misc/mediatek/heart_rate/pixart_pah8001/Kconfig
```kconfig
config HEART_RATE_SENSOR_PIXART_PAH8001
	bool "Sensor driver for Pixart PAH8001"
	default n
	help
	  Say Y here if you have a Pixart PAH8001 heart rate sensor.
```

## drivers/misc/mediatek/heart_rate/tyhx_hrs3300/Kconfig
```kconfig
config HEART_RATE_SENSOR_TYHX_HRS3300
	bool "Sensor driver for TYHX HRS3300"
	default n
	help
	  Say Y here if you have a TYHX HRS3300 heart rate sensor.
```

## drivers/misc/mediatek/sensor_bio/accelerometer/bma4xy/Kconfig
```kconfig
config MTK_BMA4XY
	bool "Sensor driver for Bosch BMA4XY"
	depends on I2C
	default n
	help
	  Say Y here if you have a Bosch BMA4XY acceleration sensor.
```
